## components/AntennaSwitch/Kconfig
```kconfig
menu "Antenna Switch Configuration"

    config ANTENNA_SWITCH_ENABLED
        bool "Enable external antenna switch"
        default false
        help
            Enable integration with ESP32 Band Decoder antenna switch via HTTP API.
            When enabled, the antenna button will use the external switch API
            to select compatible antennas based on operating frequency.

    config ANTENNA_SWITCH_HOST
        string "Antenna switch hostname/IP"
        depends on ANTENNA_SWITCH_ENABLED
        default "antenna-switch.local"
        help
            Hostname or IP address of the ESP32 Band Decoder antenna switch.
            Supports both IP addresses and DNS hostnames.
            Examples: "192.168.1.100", "antenna-switch.local", "myantenna.example.com"
            Do not include protocol (http://) or port number.

    config ANTENNA_SWITCH_PORT
        int "Antenna switch port"
        depends on ANTENNA_SWITCH_ENABLED
        range 1 65535
        default 80
        help
            Port number for the ESP32 Band Decoder antenna switch API.
            Default is 80 for HTTP.

    config ANTENNA_SWITCH_TIMEOUT_MS
        int "HTTP request timeout (ms)"
        depends on ANTENNA_SWITCH_ENABLED
        range 500 10000
        default 2000
        help
            Timeout for HTTP requests to the antenna switch API in milliseconds.
            Lower values provide faster button response but may cause timeouts
            on slower networks.

    config ANTENNA_SWITCH_MAX_RETRIES
        int "Maximum retry attempts"
        depends on ANTENNA_SWITCH_ENABLED
        range 1 10
        default 3
        help
            Maximum number of retry attempts for failed HTTP requests.

    config ANTENNA_SWITCH_FALLBACK_TO_RADIO
        bool "Fallback to radio antennas on API failure"
        depends on ANTENNA_SWITCH_ENABLED
        default true
        help
            When enabled, the system will fall back to the radio's built-in
            antenna switching (ANT1/ANT2) if the external antenna switch API
            is unavailable or fails.

    config ANTENNA_SWITCH_STATUS_ENDPOINT
        string "Antenna status endpoint"
        depends on ANTENNA_SWITCH_ENABLED
        default "/status"
        help
            HTTP endpoint for getting antenna status.
            Common values: "/status", "/api/status", "/antenna/status"
            
    config ANTENNA_SWITCH_CONTROL_ENDPOINT  
        string "Antenna control endpoint"
        depends on ANTENNA_SWITCH_ENABLED
        default "/api/antenna/switch"
        help
            HTTP endpoint for switching antennas.
            Common values: "/api/antenna/switch", "/switch", "/antenna"

    choice ANTENNA_SWITCH_TRANSPORT
        prompt "Transport protocol"
        depends on ANTENNA_SWITCH_ENABLED
        default ANTENNA_SWITCH_TRANSPORT_AUTO
        help
            Select the communication protocol for antenna switch.
            
        config ANTENNA_SWITCH_TRANSPORT_HTTP
            bool "HTTP only"
            help
                Use only HTTP API (original behavior).
                Most compatible with existing setups.
                
        config ANTENNA_SWITCH_TRANSPORT_WEBSOCKET
            bool "WebSocket only"
            help
                Use only WebSocket communication.
                Best for applications requiring real-time updates.
                Initialization fails if WebSocket unavailable.
                
        config ANTENNA_SWITCH_TRANSPORT_AUTO
            bool "Auto (WebSocket with HTTP fallback)"
            help
                Try WebSocket connection first, fallback to HTTP if unavailable.
                Best performance with maximum compatibility.
                
    endchoice

    config ANTENNA_SWITCH_WS_URL
        string "WebSocket URL"
        depends on ANTENNA_SWITCH_ENABLED && !ANTENNA_SWITCH_TRANSPORT_HTTP
        default "ws://antenna-switch.local/ws"
        help
            WebSocket endpoint URL for real-time communication.
            Should match the antenna switch hostname/IP with /ws path.
            Examples: "ws://192.168.1.100/ws", "ws://antenna-switch.local/ws"

    config ANTENNA_SWITCH_WS_EVENTS
        bool "Enable WebSocket real-time events"
        depends on ANTENNA_SWITCH_ENABLED && !ANTENNA_SWITCH_TRANSPORT_HTTP
        default true
        help
            Subscribe to real-time antenna status and frequency change events.
            Provides instant cache updates but uses additional memory.

    config ANTENNA_SWITCH_WS_RECONNECT_MS
        int "WebSocket reconnection timeout (ms)"
        depends on ANTENNA_SWITCH_ENABLED && !ANTENNA_SWITCH_TRANSPORT_HTTP
        range 1000 60000
        default 5000
        help
            Time to wait before attempting WebSocket reconnection after failure.

    config ANTENNA_SWITCH_WS_KEEPALIVE_MS
        int "WebSocket keep-alive interval (ms)"
        depends on ANTENNA_SWITCH_ENABLED && !ANTENNA_SWITCH_TRANSPORT_HTTP
        range 5000 120000
        default 30000
        help
            Interval for sending keep-alive ping messages to maintain connection.

endmenu
```

## components/EncoderHandler/Kconfig
```kconfig
menu "Encoder Handler Options"

config ENCODER_USE_PCNT
    bool "Use PCNT hardware for encoder"
    default y
    help
        Enable ESP32 PCNT hardware for quadrature decoding with glitch filtering.
        If disabled, fall back to GPIO ISR-based decoding.

config ENCODER_PCNT_GLITCH_US
    int "PCNT glitch filter (microseconds)"
    range 0 100
    default 6
    depends on ENCODER_USE_PCNT
    help
        Minimum pulse width to count, in microseconds.
        6 us is a good starting point for optical encoders.

config ENCODER_ACCEL_ENABLE
    bool "Enable discrete acceleration bands"
    default y
    help
        Use simple 2–3 band acceleration based on revolutions per second.

config ENCODER_BAND1_RPS_X100
    int "Band1 threshold (rps x100)"
    range 1 1000
    default 100
    depends on ENCODER_ACCEL_ENABLE
    help
        Threshold to enter medium band. 100 = 1.00 rps.

config ENCODER_BAND2_RPS_X100
    int "Band2 threshold (rps x100)"
    range 1 2000
    default 300
    depends on ENCODER_ACCEL_ENABLE
    help
        Threshold to enter fast band. 300 = 3.00 rps.

config ENCODER_BAND_HYSTERESIS_PERCENT
    int "Band hysteresis (%)"
    range 0 50
    default 20
    depends on ENCODER_ACCEL_ENABLE
    help
        Percentage hysteresis applied for downshifts to prevent flicker.

config ENCODER_LIVE_UPDATE_INTERVAL_MS
    int "Live update interval (ms)"
    range 5 100
    default 15
    help
        Cadence for live frequency updates while turning.

config ENCODER_FINAL_UPDATE_DELAY_MS
    int "Final update delay (ms)"
    range 10 200
    default 50
    help
        Delay after last movement before sending final update.

config ENCODER_MIN_STEPS_THRESHOLD
    int "Minimum logical pulses per update"
    range 0 10
    default 1
    help
        Minimum logical step count before an update is considered.

config ENCODER_GPIO_SW_FILTER_US
    int "GPIO software glitch filter (microseconds)"
    range 0 100
    default 20
    depends on !ENCODER_USE_PCNT
    help
        Software glitch filter for GPIO ISR mode to improve noise immunity.
        Applied in addition to GPIO pull-ups. 0 = disabled.

config ENCODER_VERBOSE_LOGS
    bool "Enable verbose encoder logging"
    default n
    help
        Enable detailed logging for encoder debugging. Disable in production
        to reduce ISR-to-task latency and improve performance.

config ENCODER_RADIO_USE_RELATIVE_CMDS
    bool "Send UP/DN increments to radio instead of FA/FB"
    default n
    help
        When enabled, the encoder issues relative UP/DN CAT commands toward the
        radio for tuning while still broadcasting absolute FA/FB updates to USB
        and the display. Disable to use traditional absolute FA/FB commands for
        radio tuning.

endmenu
```

## components/NvsManager/Kconfig
```kconfig
menu "NVS Manager Configuration"

config ENABLE_NVS_PERSISTENCE
    bool "Enable NVS persistence"
    default y
    help
        Enable saving radio state to Non-Volatile Storage (NVS).
        When enabled, radio state will be automatically saved periodically
        and restored on boot. When disabled, state is only kept in memory.

config NVS_SAVE_INTERVAL_MS
    int "NVS save interval (milliseconds)"
    depends on ENABLE_NVS_PERSISTENCE
    default 30000
    range 1000 300000
    help
        Interval in milliseconds between automatic saves to NVS.
        Minimum: 1000ms (1 second)
        Maximum: 300000ms (5 minutes)
        Default: 30000ms (30 seconds)

endmenu
```

## components/RadioCore/Kconfig
```kconfig
menu "RadioCore Options"


config RADIOCORE_ID_STRING
    string "Default Radio ID (IDxxx;)"
    default "023"
    help
        Default radio ID string returned by ID; queries when not overridden.
        For TS-590SG this is typically 023. For TS-2000, use 020.

config RADIOCORE_FV_STRING
    string "Default Firmware Version (FVy.yy;)"
    default "1.04"
    help
        Default firmware version string returned by FV; queries when not overridden.

config TRANSVERTER_SUPPORT
    bool "Enable transverter support"
    default y
    help
        Enable transverter functionality including EX056 menu handling,
        XO offset commands, and transverter macros. Required for use with
        transverters and microwave equipment.
        
        When disabled, transverter-related features are compiled out to
        save flash/RAM for systems that don't need transverter functionality.

config TRANSVERTER_DISPLAY_OFFSET
    bool "Compile transverter XO offset to FA/FB display support"
    default y
    depends on TRANSVERTER_SUPPORT
    help
        When enabled, compiles in support for applying XO transverter offset
        to FA/FB frequencies reported to the USB host.

        The feature is controlled at runtime via UIXD command:
        - UIXD1; enables offset display (FA/FB include XO offset)
        - UIXD0; disables offset display (strict TS-590SG compatibility)

        This option is only available when transverter support is enabled.

config RADIOCORE_EMULATE_TS2000
    bool "Emulate Kenwood TS-2000 responses (ID019, FV1.20)"
    default n
    help
        When enabled, ID; responds with ID020; and FV; responds with FV1.20; to
        better align with TS-2000 behavior, useful for transverter workflows.

## Polling functionality removed
## The following options were intentionally deleted to eliminate internal polling:
## - RADIOCORE_SMART_POLLING and related TTL presets
## - RADIOCORE_METER_POLLING and burst polling controls
## - RADIOCORE_INTERNAL_POLLING and SYNC interval/activity tuning

# Auto-readback after SET (replaces polling for confirmation)
config RADIOCORE_AUTO_QUERY_AFTER_SET
    bool "Send READ after SET (auto-readback)"
    default y
    help
        When enabled, the router automatically sends the corresponding READ
        command to the radio after processing a local SET (from USB or Display).
        This confirms that the radio applied the change and updates local state
        from the authoritative source. These READs bypass cache TTL logic.

config RADIOCORE_AUTO_QUERY_RESPECT_AI
    bool "Skip auto-readback when AI2/AI4 is active"
    default n
    help
        When enabled, auto-readback is suppressed if the radio is in AI2/AI4
        mode (since the radio will broadcast updates itself). Leave disabled
        to always confirm via a READ after SET.

config RADIOCORE_MANUAL_KEEPALIVE
    bool "Enable Manual KeepAlive (RRC-1258 compatibility)"
    default n
    help
        When enabled, the interface will periodically send PS1; commands to
        radioSerial to maintain the RRC-1258 connection. This prevents the
        RRC unit from timing out when no external commands are being sent.

config RADIOCORE_MANUAL_KEEPALIVE_TIME
    int "Manual KeepAlive interval (milliseconds)"
    default 1000
    range 100 60000
    depends on RADIOCORE_MANUAL_KEEPALIVE
    help
        Time interval in milliseconds between PS1; keepalive transmissions.
        Default is 1000ms (1 second). Range: 100ms to 60s.

endmenu
```

## components/WiFiManager/Kconfig
```kconfig
menu "WiFi Configuration"

    config WIFI_SSID
        string "WiFi SSID"
        default "YourWiFiNetwork"
        help
            WiFi network name (SSID) to connect to.
            Enter your wireless network name here.

    config WIFI_PASSWORD
        string "WiFi Password"
        default "YourWiFiPassword"
        help
            WiFi network password.
            Leave empty for open networks (not recommended).

    config WIFI_HOSTNAME
        string "WiFi Hostname"
        default "arci"
        help
            Network hostname for the ESP32 device.
            This hostname will be used for DHCP and mDNS resolution.
            Valid characters: a-z, 0-9, hyphen (max 32 chars).
            Default is "arci".
            
    config WIFI_MAXIMUM_RETRY
        int "Maximum retry attempts"
        default 5
        help
            Maximum number of connection retry attempts before giving up.
            
    config WIFI_CONNECTION_TIMEOUT_MS
        int "Connection timeout (ms)"
        range 5000 60000
        default 15000
        help
            Timeout for WiFi connection attempts in milliseconds.
            Increase for networks with slow DHCP or weak signal.

    config WIFI_AUTO_RECONNECT
        bool "Enable automatic reconnection"
        default true
        help
            Automatically attempt to reconnect when WiFi connection is lost.
            Recommended for reliable operation.

endmenu
```

## components/unit_test/Kconfig
```kconfig
menu "Unit Testing"

config RUN_UNIT_TESTS
    bool "Enable unit tests"
    default n
    help
        Enable unit tests to run at startup.
        
endmenu
```

## sdkconfig.defaults
```kconfig
# Enable USB CDC support via TinyUSB
CONFIG_TINYUSB_CDC_ENABLED=y
CONFIG_TINYUSB_CDC_COUNT=2
# Increase CDC ring buffers for higher throughput and fewer wakeups
CONFIG_TINYUSB_CDC_RX_BUFSIZE=256
CONFIG_TINYUSB_CDC_TX_BUFSIZE=256
# Use Espressif VID but custom descriptors for other settings
CONFIG_TINYUSB_DESC_USE_ESPRESSIF_VID=y
CONFIG_TINYUSB_DESC_USE_DEFAULT_PID=n
# Custom PID to match our working configuration
CONFIG_TINYUSB_DESC_CUSTOM_PID=0x4001
# Custom device version and strings to match our descriptors
CONFIG_TINYUSB_DESC_BCD_DEVICE=0x0100
CONFIG_TINYUSB_DESC_MANUFACTURER_STRING="Stian Eklund"
CONFIG_TINYUSB_DESC_PRODUCT_STRING="ARCI"
CONFIG_TINYUSB_DESC_SERIAL_STRING="001"
CONFIG_TINYUSB_DESC_CDC_STRING="ARCI CAT Interface"

# WiFi Hostname Configuration
CONFIG_WIFI_HOSTNAME="arci"

# Log level settings
CONFIG_LOG_DEFAULT_LEVEL_INFO=y

# Main task stack size - increased for unit tests with RadioManager
CONFIG_ESP_MAIN_TASK_STACK_SIZE=8192

# Enable FreeRTOS runtime statistics for CPU usage monitoring
CONFIG_FREERTOS_GENERATE_RUN_TIME_STATS=y
CONFIG_FREERTOS_USE_TRACE_FACILITY=y
CONFIG_FREERTOS_USE_STATS_FORMATTING_FUNCTIONS=y

# --- Encoder Handler defaults (digit-anchored acceleration) ---
CONFIG_ENCODER_USE_PCNT=y
CONFIG_ENCODER_PCNT_GLITCH_US=6
CONFIG_ENCODER_ACCEL_ENABLE=y
CONFIG_ENCODER_BAND1_RPS_X100=30
CONFIG_ENCODER_BAND2_RPS_X100=120
CONFIG_ENCODER_BAND_HYSTERESIS_PERCENT=20
CONFIG_ENCODER_LIVE_UPDATE_INTERVAL_MS=15
CONFIG_ENCODER_FINAL_UPDATE_DELAY_MS=50
CONFIG_ENCODER_MIN_STEPS_THRESHOLD=1
```
