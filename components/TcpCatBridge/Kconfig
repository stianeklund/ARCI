## components/TcpCatBridge/Kconfig
```kconfig
menu "TCP CAT Bridge Configuration"

    config TCP_CAT_BRIDGE_ENABLE
        bool "Enable TCP CAT Bridge"
        default y
        help
            Enable TCP server that provides network access to CAT command interface.
            Allows remote CAT control over TCP/IP connections.

    config TCP_CAT_BRIDGE_PORT_0
        int "TCP Server Port for Bridge 0"
        default 7373
        depends on TCP_CAT_BRIDGE_ENABLE
        help
            TCP port number for bridge 0 server to listen on.
            Default: 7373

    config TCP_CAT_BRIDGE_PORT_1
        int "TCP Server Port for Bridge 1"
        default 7374
        depends on TCP_CAT_BRIDGE_ENABLE
        help
            TCP port number for bridge 1 server to listen on.
            Default: 7374

    config TCP_CAT_BRIDGE_ENABLE_DUAL
        bool "Enable dual TCP bridges (Bridge 0 and Bridge 1)"
        default y
        depends on TCP_CAT_BRIDGE_ENABLE
        help
            Enable both TCP bridges for independent CAT access.
            Disable to only use bridge 0 (saves ~22KB RAM).

    config TCP_CAT_BRIDGE_MAX_CLIENTS
        int "Maximum Concurrent Clients"
        default 2
        range 1 4
        depends on TCP_CAT_BRIDGE_ENABLE
        help
            Maximum number of simultaneous TCP client connections.
            Each client consumes ~7-9 KB of memory.

    config TCP_CAT_BRIDGE_BUFFER_SIZE
        int "Bridge Buffer Size (bytes)"
        default 256
        range 128 1024
        depends on TCP_CAT_BRIDGE_ENABLE
        help
            Size of TX/RX buffers per client connection.
            CAT frames are typically <64 bytes, so 256 is safe.

    config TCP_CAT_BRIDGE_TASK_STACK_SIZE
        int "Bridge Task Stack Size (bytes)"
        default 6144
        range 2048 16384
        depends on TCP_CAT_BRIDGE_ENABLE
        help
            Stack size for the TCP bridge task.
            The frame callback dispatches through the full command handler chain,
            which requires ~5-6KB of stack depth.

    config TCP_CAT_BRIDGE_TASK_PRIORITY
        int "Bridge Task Priority"
        default 5
        range 1 24
        depends on TCP_CAT_BRIDGE_ENABLE
        help
            FreeRTOS task priority for the TCP bridge.
            5 = medium priority (same as main tasks).

    config TCP_CAT_BRIDGE_SELECT_TIMEOUT_MS
        int "Select Timeout (milliseconds)"
        default 100
        range 10 1000
        depends on TCP_CAT_BRIDGE_ENABLE
        help
            Timeout for select() call in the bridge task loop.
            Lower values = more responsive, higher CPU usage.

    config TCP_CAT_BRIDGE_BIND_ADDR
        string "Bind Address"
        default "0.0.0.0"
        depends on TCP_CAT_BRIDGE_ENABLE
        help
            IPv4 address the bridge listens on.
            "0.0.0.0" (default) binds all interfaces. Set to a specific interface
            address (e.g. a private-LAN or AP-only address) to limit exposure of
            the CAT control surface. An empty or unparseable value falls back to
            0.0.0.0.

    config TCP_CAT_BRIDGE_AUTH_TOKEN
        string "Auth Token"
        default ""
        depends on TCP_CAT_BRIDGE_ENABLE
        help
            Optional shared-secret token gating access to the CAT control surface.

            Empty (default) = authentication DISABLED for Hamlib/N1MM compatibility.
            WARNING: with auth disabled, anyone who can reach this TCP port on the
            network can issue CAT commands, including PTT and RF power — they can
            key your transmitter. Prefer binding to a trusted interface and/or
            setting a token when the port is reachable from an untrusted network.

            When non-empty, a new connection's FIRST frame must be exactly
            "AUTH <token>;". On match the bridge replies "AUTH1;" and enters normal
            CAT mode; any other first frame closes the connection. Frames received
            before successful auth are never forwarded to the radio. The existing
            authenticated client is only evicted once a newcomer authenticates, so
            a reconnect loop cannot knock the active operator offline.

    config TCP_CAT_BRIDGE_MIN_ACCEPT_INTERVAL_MS
        int "Minimum Accept Interval (milliseconds)"
        default 1000
        range 0 10000
        depends on TCP_CAT_BRIDGE_ENABLE
        help
            Minimum time between accepted client connections. Connections arriving
            faster than this are dropped immediately, blunting reconnect-loop
            denial-of-service (which, with auth disabled, would otherwise churn the
            active client via evict-on-connect). 0 disables the throttle.

endmenu
```
